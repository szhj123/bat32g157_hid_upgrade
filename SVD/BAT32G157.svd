# BAT32G157 register map
Vendor: Cmsemicon; Series: BAT32G157; File version: 1.0
CPU: CM0+ r0p1, little endian, no MPU, no FPU, VTOR, 2 interrupt priority bits
Registers are 8-bit, read-write, reset 0x0 unless marked. A register's access mark holds for its fields unless they carry their own. Offsets are from the block's base; [hi:lo] are bit positions; {n}, {i} and the like mark numbered series; 'fields as' and 'values as' point back to an identical list.

## PORT — Port functions
Base 0x40040000
0x00 PA 16-bit (reset mask 0x7FFF) — Port register A
0x02 PB 16-bit (reset mask 0x1FF) — Port register B
0x04 PC 16-bit — Port register C
0x06 PD 16-bit — Port register D
0x0E PH 16-bit (reset mask 0x1F) — Port register H
0x10 PMA 16-bit reset 0xFFFF (reset mask 0x7FFF) — Port mode register A
0x12 PMB 16-bit reset 0xFFFF (reset mask 0x1FF) — Port mode register B
0x14 PMC 16-bit reset 0xFFFF — Port mode register C
0x16 PMD 16-bit reset 0xFFFF — Port mode register D
0x1E PMH 16-bit reset 0xFFFF (reset mask 0x1E) — Port mode register H
0x20 PUA 16-bit reset 0x400 (reset mask 0x7C7F) — Pull-up resistor option register A
0x22 PUB 16-bit reset 0x8 (reset mask 0x1FF) — Pull-up resistor option register B
0x24 PUC 16-bit — Pull-up resistor option register C
0x26 PUD 16-bit reset 0x1 — Pull-up resistor option register D
0x2E PUH 16-bit reset 0x3 (reset mask 0x7) — Pull-up resistor option register H
0x30 PDA 16-bit (reset mask 0x7E7F) — Pull-down resistor option register A
0x32 PDB 16-bit (reset mask 0x1FF) — Pull-down resistor option register B
0x34 PDC 16-bit — Pull-down resistor option register C
0x36 PDD 16-bit — Pull-down resistor option register D
0x40 POMA 16-bit (reset mask 0x7FFF) — Port output mode register A
0x42 POMB 16-bit (reset mask 0x1FF) — Port output mode register B
0x44 POMC 16-bit — Port output mode register C
0x46 POMD 16-bit — Port output mode register D
0x4E POMH 16-bit (reset mask 0x1E) — Port output mode register H
0x50 PMCA 16-bit reset 0xFFFF (reset mask 0x787F) — Port mode control register A
0x52 PMCB 16-bit reset 0xFFF7 (reset mask 0x1DE) — Port mode control register B
0x54 PMCC 16-bit reset 0xFFFF (reset mask 0xFFF) — Port mode control register C
0x56 PMCD 16-bit reset 0xFFFF (reset mask 0x1F0) — Port mode control register D
0x60 PSETA 16-bit (reset mask 0x7FFF) — Port set register A
0x62 PSETB 16-bit — Port set register B
0x64 PSETC 16-bit — Port set register C
0x66 PSETD 16-bit — Port set register D
0x6E PSETH 16-bit (reset mask 0x1E) — Port set register H
0x70 PCLRA 16-bit (reset mask 0x7FFF) — Port clear register A
0x72 PCLRB 16-bit (reset mask 0x1FF) — Port clear register B
0x74 PCLRC 16-bit — Port clear register C
0x76 PCLRD 16-bit — Port clear register D
0x7E PCLRH 16-bit (reset mask 0x1E) — Port clear register H
0x80 PREADA 16-bit (reset mask 0x7FFF) — Port read register A
0x82 PREADB 16-bit (reset mask 0x1FF) — Port read register B
0x84 PREADC 16-bit — Port read register C
0x86 PREADD 16-bit — Port read register D
0x8E PREADH 16-bit (reset mask 0x1F) — Port read register H
0x47D USBPMR reset 0x3 — USB port configuration register
  [1:0] DMPMR — USB_DP and USB_DM pin function select
    0=GPIO (PA07 and PA08 did not use as USB pins); 3=USB (PA07 used as USB_DP and PA08 used as USB_DM)
0x47E USBPRCR — USB port configuration protect register
0x900 PB00CFG — Alterate Output Function configuration register
  [3:0] CFG
    0=GPIO (Port used as GPIO); {v}=TO{v-1:02} (Port used as TO{v-1:02}) (v=1..4); 5=SDO00/TxD0 (Port used as SDO00/TxD0)
0x901 PH04CFG — Alterate Output Function configuration register
  fields as PB00CFG
0x902 PH03CFG — Alterate Output Function configuration register
  fields as PB00CFG
0x903 PH02CFG — Alterate Output Function configuration register
  fields as PB00CFG
0x904 PH01CFG — Alterate Output Function configuration register
  fields as PB00CFG
0x905 PC14CFG — Alterate Output Function configuration register
  fields as PB00CFG
0x906 PC15CFG — Alterate Output Function configuration register
  fields as PB00CFG
{0x8FF+i} PC{i:02}CFG (i=8..11) — Alterate Output Function configuration register
  fields as PB00CFG
{0x90B+i} PA{i:02}CFG (i=0..3) — Alterate Output Function configuration register
  fields as PB00CFG
{0x908+i} PD{i:02}CFG (i=7..11) — Alterate Output Function configuration register
  fields as PB00CFG
{0x91D+i} PC{i:02}CFG (i=3..7) — Alterate Output Function configuration register
  [3:0] CFG
    0=GPIO (Port used as GPIO); {v}=TO{v+9} (Port used as TO{v+9}) (v=1..4); 5=SDO10/TxD1 (Port used as SDO10/TxD1); 6=SPIHS0_SCKO (Port used as SPIHS0_SCKO); 7=SPIHS0_MO (Port used as SPIHS0_MO); 8=SPIHS0_SO (Port used as SPIHS0_SO)
0x925 PC12CFG — Alterate Output Function configuration register
  fields as PC03CFG
0x926 PC13CFG — Alterate Output Function configuration register
  fields as PC03CFG
{0x923+i} PA{i:02}CFG (i=4..10) — Alterate Output Function configuration register
  fields as PC03CFG
0x92E PD00CFG — Alterate Output Function configuration register
  fields as PC03CFG
0x92F PD01CFG — Alterate Output Function configuration register
  fields as PC03CFG
{0x924+i} PD{i}CFG (i=12..15) — Alterate Output Function configuration register
  fields as PC03CFG
{0x93F+i} PB{i:02}CFG (i=1..8) — Alterate Output Function configuration register
  [3:0] CFG
    0=GPIO (Port used as GPIO); {v}=TO{v+13} (Port used as TO{v+13}) (v=1..4); 5=SDO10/TxD1 (Port used as SDO20/TxD2); 6=CLKBUZ1 (Port used as CLKBUZ1)
{0x948+i} PC{i:02}CFG (i=0..2) — Alterate Output Function configuration register
  fields as PB01CFG
{0x940+i} PA{i}CFG (i=11..14) — Alterate Output Function configuration register
  fields as PB01CFG
{0x94D+i} PD{i:02}CFG (i=2..6) — Alterate Output Function configuration register
  fields as PB01CFG
{0x980+i} TI{i:02}PCFG (reset mask 0x1F) (i=0..3) — Alternate function pin configuration register
  [5:0] CFG
    1=PB00 (PB00 used as peripheral function pin); 2=PH04 (PH04 used as peripheral function pin); 3=PH03 (PH03 used as peripheral function pin); 4=PH02 (PH02 used as peripheral function pin); 5=PH01 (PH01 used as peripheral function pin); 6=PC14 (PC14 used as peripheral function pin); 7=PC15 (PC15 used as peripheral function pin); {v}=PC{v:02} (PC{v:02} used as peripheral function pin) (v=8..11); {v}=PA{v-12:02} (PA{v-12:02} used as peripheral function pin) (v=12..15); {v}=PD{v-9:02} (PD{v-9:02} used as peripheral function pin) (v=16..20)
0x984 RXD0PCFG (reset mask 0x1F) — Alternate function pin configuration register
  fields as TI00PCFG
0x984 SDI00PCFG (alternate view of RXD0PCFG)
0x985 SCLA0PCFG (reset mask 0x1F) — Alternate function pin configuration register
  fields as TI00PCFG
0x986 SDAA0PCFG (reset mask 0x1F) — Alternate function pin configuration register
  fields as TI00PCFG
{0x996+i} TI{i}PCFG (reset mask 0x1F) (i=10..13) — Alternate function pin configuration register
  [5:0] CFG
    {v}=PC{v+2:02} (PC{v+2:02} used as peripheral function pin) (v=1..5); 6=PC12 (PC12 used as peripheral function pin); 7=PC13 (PC13 used as peripheral function pin); {v}=PA{v-4:02} (PA{v-4:02} used as peripheral function pin) (v=8..14); 15=PD00 (PD00 used as peripheral function pin); 16=PD01 (PD01 used as peripheral function pin); {v}=PD{v-5} (PD{v-5} used as peripheral function pin) (v=17..20)
0x9A4 RXD1PCFG (reset mask 0x1F) — Alternate function pin configuration register
  fields as TI10PCFG
0x9A4 IRRXDPCFG (alternate view of RXD1PCFG)
0x9A4 SDI10PCFG (alternate view of RXD1PCFG)
0x9A5 SPIHS0_SCKIPCFG (reset mask 0x1F) — Alternate function pin configuration register
  fields as TI10PCFG
0x9A6 SPIHS0_SIPCFG (reset mask 0x1F) — Alternate function pin configuration register
  fields as TI10PCFG
0x9A7 SPIHS0_MIPCFG (reset mask 0x1F) — Alternate function pin configuration register
  fields as TI10PCFG
{0x9B2+i} TI{i}PCFG (reset mask 0x1F) (i=14..17) — Alternate function pin configuration register
  [5:0] CFG
    {v}=PB{v:02} (PB{v:02} used as peripheral function pin) (v=1..8); 9=PC00 (PC00 used as peripheral function pin); 10=PC01 (PC01 used as peripheral function pin); 11=PC02 (PC02 used as peripheral function pin); {v}=PA{v-1} (PA{v-1} used as peripheral function pin) (v=12..15); {v}=PD{v-14:02} (PD{v-14:02} used as peripheral function pin) (v=16..20)
0x9C4 RXD2PCFG (reset mask 0x1F) — Alternate function pin configuration register
  fields as TI14PCFG
0x9C4 SDI20PCFG (alternate view of RXD2PCFG)
0x9C5 SPIHS1_NSSPCFG (reset mask 0x1F) — Alternate function pin configuration register
  fields as TI14PCFG
0x9C6 SCLA1PCFG (reset mask 0x1F) — Alternate function pin configuration register
  fields as TI14PCFG
0x9C7 SDAA1PCFG (reset mask 0x1F) — Alternate function pin configuration register
  fields as TI14PCFG
0x9E0 INTP0PCFG — Alternate INTP pin configuration register
  [2:0] CFG
    {v}=PC{v:02} (PC{v:02} used as INTP0 pin) (v=0..7)
0x9E1 INTP1PCFG — Alternate INTP pin configuration register
  [2:0] CFG
    {v}=PC{v+12} (PC{v+12} used as INTP1 pin) (v=0..3); {v}=PC{v+4:02} (PC{v+4:02} used as INTP1 pin) (v=4..7)
0x9E2 INTP2PCFG — Alternate INTP pin configuration register
  [2:0] CFG
    {v}=PA{v:02} (PA{v:02} used as INTP2 pin) (v=0..3); {v}=PA{v+7} (PA{v+7} used as INTP2 pin) (v=4..7)
0x9E3 INTP3PCFG — Alternate INTP pin configuration register
  [2:0] CFG
    {v}=PA{v+4:02} (PA{v+4:02} used as INTP3 pin) (v=0..6)
0x9E4 INTP4PCFG — Alternate INTP pin configuration register
  [2:0] CFG
    0=PD00 (PD00 used as INTP4 pin); 1=PD01 (PD01 used as INTP4 pin); {v}=PD{v+10} (PD{v+10} used as INTP4 pin) (v=2..5); 6=PD02 (PD02 used as INTP4 pin); 7=PD03 (PD03 used as INTP4 pin)
0x9E5 INTP5PCFG — Alternate INTP pin configuration register
  [2:0] CFG
    {v}=PD{v+4:02} (PD{v+4:02} used as INTP5 pin) (v=0..7)
0x9E6 INTP6PCFG — Alternate INTP pin configuration register
  [2:0] CFG
    0=PB00 (PB00 used as INTP6 pin); 1=PH04 (PH04 used as INTP6 pin); 2=PH03 (PH03 used as INTP6 pin); 3=PH02 (PH02 used as INTP6 pin); 4=PH01 (PH01 used as INTP6 pin); 5=PB01 (PB01 used as INTP6 pin); 6=PB02 (PB02 used as INTP6 pin)
0x9E7 INTP7PCFG — Alternate INTP pin configuration register
  [2:0] CFG
    {v}=PB{v+3:02} (PB{v+3:02} used as INTP7 pin) (v=0..5)
